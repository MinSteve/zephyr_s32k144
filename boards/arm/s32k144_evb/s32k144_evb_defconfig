## boards/arm/s32k144_evb/s32k144_evb_defconfig
```kconfig
CONFIG_SOC_S32K14=y
CONFIG_BOARD_S32K144EVB=y
CONFIG_SOC_SERIES_S32K14X=y
CONFIG_SYS_CLOCK_HW_CYCLES_PER_SEC=48000000
CONFIG_GPIO=y

# so that the application has more RAM for itself.
CONFIG_MAIN_STACK_SIZE=512

CONFIG_CONSOLE=n
CONFIG_UART_CONSOLE=n
CONFIG_SERIAL=n
```

## dts/bindings/gpio/nxp,s32k14-port.yaml
```yaml
description: S32K14 GPIO node

compatible: "nxp,s32k14-gpio"

include: [gpio-controller.yaml, base.yaml]

properties:
    reg:
      required: true

    label:
      required: true

    "#gpio-cells":
      const: 2

    nxp,s32k14-port:
      required: true
      type: phandle
      description: |
        A phandle reference to the device tree node that contains the pinmux
        port associated with this GPIO controller.

gpio-cells:
  - pin
  - flags
```

## soc/arm/nxp_s32/s32k14x/Kconfig.defconfig.s32k14
```kconfig
# NXP S32K platform configuration options

# Copyright (c) 2021, Dung
# SPDX-License-Identifier: Apache-2.0

if SOC_S32K14

config SOC
	default "s32k14"

config NUM_IRQS
	# must be >= the highest interrupt number used
	default 86

endif # SOC_S32K14
```

## soc/arm/nxp_s32/s32k14x/Kconfig.defconfig.series
```kconfig
# S32K14X series configuration options

# Copyright (c) 2021, Dung Tran
# SPDX-License-Identifier: Apache-2.0

if SOC_SERIES_S32K14X

config SOC_SERIES
	default "s32k14x"

source "soc/arm/nxp_s32/*/Kconfig.defconfig.s32k14"

endif # SOC_SERIES_S32K14X
```

## soc/arm/nxp_s32/s32k14x/Kconfig.soc
```kconfig
# NXP S32K14X MCU line

# Copyright (c) 2021, Dung Tran
# SPDX-License-Identifier: Apache-2.0

choice
	prompt "NXP S32K14X MCU Selection"
	depends on SOC_SERIES_S32K14X

config SOC_S32K14
	bool "SOC_S32K14"

endchoice

if SOC_SERIES_S32K14X

config SOC_PART_NUMBER_S32K144
	bool

# config SOC_PART_NUMBER_S32K144
# 	string
# 	default "S32K144" if SOC_PART_NUMBER_S32K144
# 	help
# 	  This string holds the full part number of the SoC. It is a hidden
# 	  option that you should not set directly. The part number selection
# 	  choice defines the default value for this string.

endif # SOC_SERIES_S32K14X
```
